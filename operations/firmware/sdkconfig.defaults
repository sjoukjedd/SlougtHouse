## operations/firmware/sdkconfig.defaults
```kconfig
# VU-AMS ESP32-S3 SDK configuration defaults
# Target: ESP32-S3-MINI-1-N8R8 (8 MB Flash, 8 MB PSRAM)

CONFIG_IDF_TARGET="esp32s3"

# Flash
CONFIG_ESPTOOLPY_FLASHSIZE_8MB=y
CONFIG_PARTITION_TABLE_CUSTOM=n

# PSRAM — octal SPI PSRAM on S3-MINI-1-N8R8
CONFIG_ESP32S3_SPIRAM_SUPPORT=y
CONFIG_SPIRAM_MODE_OCT=y
CONFIG_SPIRAM_SPEED_80M=y
CONFIG_SPIRAM_USE_MALLOC=n
CONFIG_SPIRAM_MALLOC_ALWAYSINTERNAL=16384

# CPU speed
CONFIG_ESP32S3_DEFAULT_CPU_FREQ_240=y

# FreeRTOS
CONFIG_FREERTOS_HZ=1000
CONFIG_FREERTOS_USE_TICKLESS_IDLE=n
CONFIG_FREERTOS_UNICORE=n

# BLE — NimBLE stack
CONFIG_BT_ENABLED=y
CONFIG_BT_NIMBLE_ENABLED=y
CONFIG_BT_NIMBLE_MAX_CONNECTIONS=1
CONFIG_BT_NIMBLE_ATT_PREFERRED_MTU=512

# SPI DMA
CONFIG_SPI_MASTER_ISR_IN_IRAM=y

# Logging
CONFIG_LOG_DEFAULT_LEVEL_INFO=y
CONFIG_LOG_MAXIMUM_LEVEL_DEBUG=y

# Watchdog
CONFIG_ESP_TASK_WDT=y
CONFIG_ESP_TASK_WDT_TIMEOUT_S=5
CONFIG_ESP_TASK_WDT_CHECK_IDLE_TASK_CPU0=n
CONFIG_ESP_TASK_WDT_CHECK_IDLE_TASK_CPU1=n

# NVS
CONFIG_NVS_ASSERT_ERROR_CHECK=n

# FAT filesystem for SD card
CONFIG_FATFS_LFN_HEAP=y
CONFIG_FATFS_MAX_LFN=255
```

## operations/firmware_dummy/sdkconfig.defaults
```kconfig
# =============================================================================
# VU-AMS Dummy Firmware — sdkconfig defaults
# Target: ESP32-S3-DevKitC-1 (ESP32-S3, 8 MB flash, no PSRAM required)
# =============================================================================

# Target chip
CONFIG_IDF_TARGET="esp32s3"

# Flash size (DevKitC-1 ships with 8 MB)
CONFIG_ESPTOOLPY_FLASHSIZE_8MB=y
CONFIG_ESPTOOLPY_FLASHSIZE="8MB"

# --- Bluetooth: NimBLE only (no Bluedroid) ---
CONFIG_BT_ENABLED=y
CONFIG_BT_NIMBLE_ENABLED=y
CONFIG_BT_CONTROLLER_ENABLED=y
CONFIG_BT_NIMBLE_ROLE_BROADCASTER=y
CONFIG_BT_NIMBLE_ROLE_PERIPHERAL=y
# Disable roles not needed
CONFIG_BT_NIMBLE_ROLE_OBSERVER=n
CONFIG_BT_NIMBLE_ROLE_CENTRAL=n

# MTU: iOS requests 185 bytes; 247 is the NimBLE default maximum
CONFIG_BT_NIMBLE_ATT_PREFERRED_MTU=247

# Maximum connections: we only need 1
CONFIG_BT_NIMBLE_MAX_CONNECTIONS=1

# NimBLE host task stack (default 4096 is sufficient)
CONFIG_BT_NIMBLE_HOST_TASK_STACK_SIZE=4096

# --- NVS ---
CONFIG_NVS_FLASH_MAX_PAGES=6

# --- FreeRTOS ---
CONFIG_FREERTOS_HZ=1000

# --- Logging ---
CONFIG_LOG_DEFAULT_LEVEL_INFO=y

# --- Newlib (needed for math functions like expf, sinf) ---
CONFIG_NEWLIB_STDOUT_LINE_ENDING_CRLF=y
```
